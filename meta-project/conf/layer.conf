## meta-project/conf/layer.conf
```bitbake
# We have a conf and classes directory, add to BBPATH
BBPATH .= ":${LAYERDIR}"

# We have recipes-* directories, add to BBFILES
BBFILES += "${LAYERDIR}/recipes-*/*/*.bb \
            ${LAYERDIR}/recipes-*/*/*.bbappend"

BBFILE_COLLECTIONS += "meta-project"
BBFILE_PATTERN_meta-project = "^${LAYERDIR}/"
BBFILE_PRIORITY_meta-project = "6"

LAYERDEPENDS_meta-project = "core"
LAYERSERIES_COMPAT_meta-project = "kirkstone scarthgap"

LAYERDEPENDS_meta-project = "\
    arm-toolchain \
    meta-arm \
    meta-ti-bsp \
    meta-ti-extras \
"

LICENSE_PATH += "${LAYERDIR}/licenses"
```
